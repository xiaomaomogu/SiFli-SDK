## customer/boards/em-lb566_nand/lcpu/Kconfig.board
```kconfig
config BSP_USING_BOARD_EM_LB566_NAND
    bool
    select SOC_SF32LB56X
    select BF0_LCPU
    default y

rsource "../Kconfig.board"
```
